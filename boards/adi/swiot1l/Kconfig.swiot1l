## boards/adi/swiot1l/Kconfig.swiot1l
```kconfig
# MAX32690 board configuration

# Copyright (c) 2024 Analog Devices, Inc.
# SPDX-License-Identifier: Apache-2.0

config BOARD_SWIOT1L
	select SOC_MAX32650 if BOARD_SWIOT1L_MAX32650
```

## boards/adi/swiot1l/board.yml
```yaml
# Copyright (c) 2024 Analog Devices, Inc.
# SPDX-License-Identifier: Apache-2.0

board:
  name: swiot1l
  vendor: adi
  socs:
    - name: max32650
```

## west.yml
```yaml
# The west manifest file for upstream Zephyr.
#
# The per-installation west configuration file, .west/config, sets the
# path to the project containing this file in the [manifest] section's
# "path" variable.
#
# You are free to create your own manifest files and put them in any
# repository you want, to create your own custom Zephyr installations.
# For example, you could create a manifest file in your own out of
# tree application directory, which would pull this zephyr repository
# in as an ordinary project.
#
# You can pass your manifest repositories to west init when creating a
# new Zephyr installation. See the west documentation for more
# information.

manifest:
  defaults:
    remote: upstream

  remotes:
    - name: upstream
      url-base: https://github.com/zephyrproject-rtos

  group-filter: [-optional]

  #
  # Please add items below based on alphabetical order
  projects:
    - name: cmsis
      revision: 4b96cbb174678dcd3ca86e11e1f24bc5f8726da0
      path: modules/hal/cmsis
      groups:
        - hal
    - name: hal_adi
      revision: 0d4a117bd188a10fd86434a52b97598faf1c4e49
      path: modules/hal/adi
      url: https://github.com/CiprianRegus/hal_adi
      groups:
        - hal
    - name: hipflowapp
      revision: ca8696ae7de25b82b86fc2742649aefcf19c0d3c
      path: modules/hipflowapp
      url: https://github.com/CiprianRegus/hipflowapp.git
      groups:
        - hal
    - name: hipserver
      revision: 1d563c21d24e4e2c89dc8c63d810e38d0955e6d4
      path: modules/hipflowapp/hipflowapp/Hip_Native/hipserver
      url: https://github.com/CiprianRegus/hipserver.git
      groups:
        - hal

  self:
    path: zephyr
    west-commands: scripts/west-commands.yml
    import: submanifests
```
